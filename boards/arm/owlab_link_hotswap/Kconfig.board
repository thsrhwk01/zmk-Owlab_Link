## boards/arm/owlab_link_hotswap/Kconfig.board
```kconfig
config BOARD_OWLAB_LINK_HOTSWAP
    bool "Owlab Link"
    depends on SOC_STM32F103XB
```

## boards/arm/owlab_link_hotswap/Kconfig.defconfig
```kconfig
if BOARD_OWLAB_LINK_HOTSWAP

config BOARD
    default "owlab_link_hotswap"

config ZMK_KEYBOARD_NAME
    default "Owlab Link"

config ZMK_USB
    default y

config ZMK_KSCAN_MATRIX_POLLING
    default y

endif # BOARD_OWLAB_LINK_HOTSWAP
```
